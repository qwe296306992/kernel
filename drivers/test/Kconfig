## drivers/test/Kconfig
```kconfig
# SPDX-License-Identifier: GPL-2.0
menuconfig YS_TEST
	bool "YSkinder Test sample"
	help
	  Yskinder Test code.

if YS_TEST

menu "Kernel prompt test sample"
source drivers/test/prompt_test/Kconfig
endmenu

menu "Kernel workqueue test sample"
source drivers/test/work_queue/Kconfig
endmenu

menu "Kernel irq test sample"
source drivers/test/irq/Kconfig
endmenu

endif # YS_TEST
```

## drivers/test/irq/Kconfig
```kconfig
# SPDX-License-Identifier: GPL-2.0
config KERNEL_IRQ_TEST
	tristate "Kernel IRQ test driver"
	help
	  Say Y here to enable Kernel IRQ test driver.

config SAMPLE_IRQ
    tristate "SAMPLE_IRQ Support"
    depends on KERNEL_IRQ_TEST
    help
      This option enables support for My Module.
      If DEPENDENT_OPTION is not enabled, this option will not be available.

config ATK_IRQ
    tristate "ATK_IRQ Support"
    depends on KERNEL_IRQ_TEST
    help
      This option enables support for ATK Module.
      If DEPENDENT_OPTION is not enabled, this option will not be available.
```

## drivers/test/prompt_test/Kconfig
```kconfig
# SPDX-License-Identifier: GPL-2.0
config KERNEL_PROMPT_TEST
	tristate "Kernel preemption test driver"
	help
	  Say Y here to enable Kernel preemption test driver.
```

## drivers/test/work_queue/Kconfig
```kconfig
# SPDX-License-Identifier: GPL-2.0
config KERNEL_WORKQUEUE_TEST
	tristate "Kernel WORKQUEUE test driver"
	help
	  Say Y here to enable Kernel WORKQUEUE test driver.
```
